/*
 * Copyright (C) 2015 Phytec Messtechnik GmbH
 * Author: Teresa Remmet <t.remmet@phytec.de>
 *
 * This program is free software; you can redistribute it and/or modify
 * it under the terms of the GNU General Public License version 2 as
 * published by the Free Software Foundation.
 */

/dts-v1/;

#include "am335x-phycore-som-eeprom-rtc-spi.dtsi"
#include "am335x-wega.dtsi"
#include "am335x-wega-peb-eval-01.dtsi"
#include "am335x-wega-peb-av-01.dtsi"
#include "am335x-wega-peb-av-02.dtsi"
#include "am335x-wega-peb-wlbt-01.dtsi"
