/*
 * Copyright (C) 2016 PHYTEC Messtechnik GmbH
 * Author: Teresa Remmet <t.remmet@phytec.de>
 *
 * This program is free software; you can redistribute it and/or modify
 * it under the terms of the GNU General Public License version 2 as
 * published by the Free Software Foundation.
 */

/dts-v1/;

#include "am335x-phycore-som-nand-eeprom-rtc-spi-tmp.dtsi"
#include "am335x-pcm-953.dtsi"
