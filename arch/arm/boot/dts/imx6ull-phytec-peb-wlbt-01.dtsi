// SPDX-License-Identifier: (GPL-2.0+ OR MIT)
/*
 * Copyright (C) 2018 PHYTEC Messtechnik GmbH
 * Author: Stefan Riedmueller <s.riedmueller@phytec.de>
 */

#include "imx6ul-phytec-peb-wlbt-01.dtsi"

&iomuxc {
	/delete-node/ wlangrp;
};

&iomuxc_snvs {
	pinctrl_wlan: wlangrp {
		fsl,pins = <
			MX6ULL_PAD_SNVS_TAMPER9__GPIO5_IO09	0x110a0
			MX6UL_PAD_GPIO1_IO03__GPIO1_IO03	0x10b0
		>;
	};
};
