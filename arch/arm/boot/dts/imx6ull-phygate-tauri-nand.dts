// SPDX-License-Identifier: (GPL-2.0+ OR MIT)
/*
 * Copyright (C) 2021 PHYTEC Messtechnik GmbH
 * Author: Jens Lang <j.lang@phytec.de>
 */

/dts-v1/;
#include "imx6ull-phygate-tauri.dtsi"

/ {
	model = "PHYTEC phyGate-Tauri i.MX6 UltraLite";
	compatible = "phytec,imx6ull-phygate-tauri",
		     "phytec,imx6ull-phygate-tauri-nand",
		     "phytec,imx6ull-pcl063", "fsl,imx6ull";
};

/* NAND-Version */
&gpmi {
	status = "okay";
};
