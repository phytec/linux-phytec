// SPDX-License-Identifier: (GPL-2.0+ OR MIT)
/*
 * Copyright (C) 2018 PHYTEC Messtechnik GmbH
 * Author: Stefan Riedmueller <s.riedmueller@phytec.de>
 */

#include "imx6ul-phytec-segin-peb-av-02.dtsi"

&iomuxc {
	/delete-node/ edtft5x06grp;
};

&iomuxc_snvs {
	pinctrl_edt_ft5x06: edtft5x06grp {
		fsl,pins = <
			MX6ULL_PAD_SNVS_TAMPER5__GPIO5_IO05	0x1b0b0
		>;
	};
};
