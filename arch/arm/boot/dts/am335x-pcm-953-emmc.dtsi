/*
 * Copyright (C) 2017 PHYTEC Messtechnik GmbH
 * Author: Daniel Schultz <d.schultz@phytec.de>
 *
 * This program is free software; you can redistribute it and/or modify
 * it under the terms of the GNU General Public License version 2 as
 * published by the Free Software Foundation.
 */

#include "am335x-pcm-953.dtsi"

/ {
	model = "Phytec AM335x PCM-953 EMMC";
	compatible = "phytec,am335x-pcm-953-emmc", "phytec,am335x-phycore-som", "ti,am33xx";

	/* These pins are in conflict with eMMC pins */
	/delete-node/user_leds;
};

