/*
 * Copyright (C) 2017 PHYTEC Messtechnik GmbH
 * Author: Daniel Schultz <d.schultz@phytec.de>
 *
 * This program is free software; you can redistribute it and/or modify
 * it under the terms of the GNU General Public License version 2 as
 * published by the Free Software Foundation.
 */

#include "am335x-pcm-953-wifi.dtsi"

/ {
	model = "Phytec AM335x PCM-953 EMMC";
	compatible = "phytec,am335x-pcm-953-emmc", "phytec,am335x-pcm-953-wifi", "phytec,am335x-phycore-som", "ti,am33xx";

	user_leds: user_leds {
		/* Override the user_leds node to match the PCM-062 SoM setup */
		user-led0 {
			gpios = <&gpio2 4 GPIO_ACTIVE_HIGH>;
		};

		user-led1 {
			gpios = <&gpio2 5 GPIO_ACTIVE_LOW>;
		};
	};
};

&am33xx_pinmux {
	user_leds_pins: pinmux_user_leds {
		pinctrl-single,pins = <
			AM33XX_IOPAD(0x898, PIN_OUTPUT_PULLDOWN | MUX_MODE7)    /* gpmc_wen.gpio2_4 */
			AM33XX_IOPAD(0x89c, PIN_OUTPUT_PULLDOWN | MUX_MODE7)    /* gpmc_ben0_cle.gpio2_5 */
		>;
	};
};

};

