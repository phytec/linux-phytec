/*
 * Copyright (C) 2015 PHYTEC Messtechnik GmbH
 * Author: Teresa Remmet <t.remmet@phytec.de>
 *
 * This program is free software; you can redistribute it and/or modify
 * it under the terms of the GNU General Public License version 2 as
 * published by the Free Software Foundation.
 */
/* This phycore does _not_ have spi, eeprom and rtc populated */
/dts-v1/;

#include "am335x-phycore-som.dtsi"
#include "am335x-pcm-953.dtsi"
