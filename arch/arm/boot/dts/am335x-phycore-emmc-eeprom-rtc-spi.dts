/*
 * Copyright (C) 2017 PHYTEC Messtechnik GmbH
 * Author: Daniel Schultz <d.schultz@phytec.de>
 *
 * This program is free software; you can redistribute it and/or modify
 * it under the terms of the GNU General Public License version 2 as
 * published by the Free Software Foundation.
 */

/dts-v1/;

#include "am335x-phycore-som-emmc-eeprom-rtc-spi.dtsi"
#include "am335x-pcm-953-emmc.dtsi"
