## Documentation/devicetree/bindings/display/panel/edt,etm0350g0dh6.txt
```
Emerging Display Technology Corp. ETM0350G0DH6 3.5" (320x240) WVGA TFT LCD
panel with capacitive multitouch

Required properties:
- compatible: should be "edt,etm0350g0dh6"

This binding is compatible with the simple-panel binding, which is specified
in simple-panel.txt in this directory.
```

## Documentation/devicetree/bindings/display/panel/edt,etm0430g0dh6.txt
```
Emerging Display Technology Corp. ETM0430G0DH6 4.3" (480x272) WVGA TFT LCD
panel with capacitive multitouch

Required properties:
- compatible: should be "edt,etm0430g0dh6"

This binding is compatible with the simple-panel binding, which is specified
in simple-panel.txt in this directory.
```

## Documentation/devicetree/bindings/display/panel/edt,etm0700g0edh6.txt
```
Emerging Display Technology Corp. ETM0700G0EDH6 7.0" WVGA TFT LCD panel

Required properties:
- compatible: should be "edt,etm0700g0edh6"

This panel is the same as ETM070080DH6 except for an inverted pixel clock.
ETM0700G0EDH6 is with capacitive multitouch.

This binding is compatible with the simple-panel binding, which is specified
in simple-panel.txt in this directory.
```

## Documentation/devicetree/bindings/display/panel/edt,etmv570g2dhu.txt
```
Emerging Display Technology Corp. ETMV570G2DHU 5.7" (640x480) VGA TFT LCD
panel with capacitve touch

Required properties:
- compatible: should be "edt,etmv570g2dhu"

This binding is compatible with the simple-panel binding, which is specified
in simple-panel.txt in this directory.
```

## Documentation/devicetree/bindings/leds/leds-pca9532.txt
```
NXP PCA9532 LED (incl. GPIO) controller

Required properties:
- compatible: must be "nxp,pca9530", "nxp,pca9531", "nxp,pca9532", "nxp,pca9533"
- reg: I2C address
- gpio-controller: Marks the device node as a GPIO controller.
- #gpio-cells: Should be 2:
   1) pin number
   2) optional parameters:
      - bit 0 specifies polarity (0 for normal, 1 for inverted)
- nxp,typecodes: groups of 2 bits for each of the 16 pins:
  0: None
  1: LED
  2: Beep
  3: GPIO
- nxp,statecodes: groups of 2 bits for each of the 16 pins:
  0: off
  1: on
  2: pwm0
  3: pwm1

Optional properties:
- nxp,psc: array of 2 numbers: PSC values for the two PWM channels (see datasheet)
- nxp,pwm: array of 2 numbers: PWM values for the two PWM channels (see datasheet)

Properties for LED mode:
- #address-cells: Should be 1;
- #size-cells: Should be 0;
Each led is represented as a sub-node of the nsp,pca9532 device.

LED sub-node properties:
- label : (optional) see Documentation/devicetree/bindings/leds/common.txt
- linux,default-trigger : (optional)
   see Documentation/devicetree/bindings/leds/common.txt
- reg : number of LED line (could be from 0 to 1 in pca9530, 0 to 3 in pca9533,
	0 to 7 in pca9531 or 0 to 15 in pca9532)

Example:

	pca9532: pca9532@60 {
		compatible = "nxp,pca9532";
		gpio-controller;
		#gpio-cells = <2>;
		nxp,typecodes = <0xffffffff>;
		nxp,statecodes = <0x00000000>;
		reg = <0x60>;
	};

	sd@20098000 {
		wp-gpios = <&pca9532 5 0>;
		cd-gpios = <&pca9532 4 0>;
		cd-inverted;
		bus-width = <4>;
		status = "okay";
	};
```

## Documentation/devicetree/bindings/leds/pca9532.txt
```
LEDs connected to pca9530, pca9531, pca9532 or pca9533

Required properties:
- compatible : should be : "nxp,pca9530", "nxp,pca9531", "nxp,pca9532" or
		"nxp,pca9533"
- #address-cells: must be 1
- #size-cells: must be 0
- reg: typically 0x62


Optional properties:
- nxp,pwm0 : 
- nxp,pwm1 :
- nxp,psc0 :
- nxp,psc1 :

Each led is represented as a sub-node of the nxp,pca953x device.

LED sub-node properties:
- label : (optional) see Documentation/devicetree/bindings/leds/common.txt
- reg : number of LED line (could be from 2 in pca9530 or 8 in pca9531 or 16 in
		pca9532 or 4 in pca9633)
- state: "on" or "pwm0" or "pwm1" or "off"
- type: "led" or "beep" or "gpio" or "none"
Examples:
pca9533@62 {
	compatible = "nxp,pca9533";
	#address-cells = <1>;
	#size-cells = <0>;
	reg = <0x62>;

	nxp,pwm0 = <150>;
	nxp,pwm1 = <1>;
	nxp,psc0 = <1>;
	nxp,psc1 = <1>;

	user_led1: red1_led@0 {
		label = "user_led1:red";
		reg = <0x0>;
		state = "on";
		type = "led";
	};

	user_led2: yellow1_led@1 {
		label = "user_led2:yellow";
		reg = <0x1>;
		state = "on";
		type = "led";
	};

	user_led3: yellow2_led@2 {
		label = "user_led3:yellow";
		reg = <0x2>;
		state = "pwm0";
		type = "led";
	};

	user_led4: red2_led@3 {
		label = "user_led4:red";
		reg = <0x3>;
		state = "pwm1";
		type = "led";
	};
};
```

## Documentation/devicetree/bindings/media/i2c/mt9m001.txt
```
* Aptina 1/2-Inch SXGA CMOS Digital Image Sensor

The Aptina MT9M001 is a 1/2-inch CMOS active pixel digital image sensor with
an active array size of 1312H x 1048V. It is programmable through a simple
two-wire serial interface.

Required Properties:

- compatible: value should be either one among the following
	(a) "aptina,mt9m001" for MT9M001 color sensor
	(b) "aptina,mt9m001m" for MT9M001 monochrome sensor

Optional Properties:

- link-frequencies: List of allowed link frequencies in Hz. Each frequency is
	expressed as a 64-bit big-endian integer.

For further reading on port node refer to
Documentation/devicetree/bindings/media/video-interfaces.txt.

Example:

	mt9m001@5d {
		compatible = "aptina,mt9m001";
		reg = <0x5d>;

		port {
			mt9v032_out: endpoint {
				link-frequencies = /bits/ 64
					<13000000 26600000 27000000>;
			};
		};
	};
```

## Documentation/devicetree/bindings/media/i2c/mt9p031.txt
```
* Aptina 1/2.5-Inch 5Mp CMOS Digital Image Sensor

The Aptina MT9P031 is a 1/2.5-inch CMOS active pixel digital image sensor with
an active array size of 2592H x 1944V. It is programmable through a simple
two-wire serial interface.

Required Properties:
- compatible: value should be either one among the following
	(a) "aptina,mt9p001" for MT9P001 color sensor
	(b) "aptina,mt9p001m" for MT9P001 monochrome sensor
	(c) "aptina,mt9p006" for MT9P006 color sensor
	(d) "aptina,mt9p006m" for MT9P006 monochrome sensor
	(e) "aptina,mt9p031" for MT9P031 color sensor
	(f) "aptina,mt9p031m" for MT9P031 monochrome sensor

- input-clock-frequency: Input clock frequency.

- pixel-clock-frequency: Pixel clock frequency.

Optional Properties:
- reset-gpios: Chip reset GPIO

For further reading on port node refer to
Documentation/devicetree/bindings/media/video-interfaces.txt.

Example:

	i2c0@1c22000 {
		...
		...
		mt9p031@5d {
			compatible = "aptina,mt9p031";
			reg = <0x5d>;
			reset-gpios = <&gpio3 30 0>;

			port {
				mt9p031_1: endpoint {
					input-clock-frequency = <6000000>;
					pixel-clock-frequency = <96000000>;
				};
			};
		};
		...
	};
```

## Documentation/devicetree/bindings/media/i2c/tw9910.txt
```
* Techwell TW9910 - Low Power NTSC/PAL/SECAM Video Decoder


The Techwell TW9910 is a low power NTSC/PAL/SECAM Video decoder with VBI slicer
It is programmable through a simple two-wire serial interface.

Required Properties:

- compatible: value should be "techwell,tw9910"
- link-frequencies: List of allowed link frequencies in Hz. Each frequency is
	expressed as a 64-bit big-endian integer.
- mpout: Value between 0 and 7.


For further reading on port node refer to
Documentation/devicetree/bindings/media/video-interfaces.txt.

Example:

	tw9910@45 {
		compatible = "techwell,tw9910";
		reg = <0x45>;

		port {
			tw9910_ep0: endpoint {
				bus-width = <8>;
				mpout = <7>;
				link-frequencies = /bits/ 64 <27000000>;
				remote-endpoint = <&csi0_ep>;
			};
		};
	};
```

## Documentation/devicetree/bindings/media/ti,scan921226h.txt
```
TI SCAN921226H Video Deserializer
---------------------------------

The SCAN921226H receives a LVDS serial data stream with embedded clock and
converts it to a 10-bit wide parallel data bus and recovers parallel clock.
Some CMOS sensors such as the ON Semiconductor MT9V024 produce a LVDS signal
compatible with this deserializer.

Required properties:
- compatible : should be "ti,scan921226h"
- #address-cells: should be <1>
- #size-cells: should be <0>
- port@0: serial (LVDS) input
- port@1: parallel output

The device node should contain two 'port' child nodes (one each for input and
output), in accordance with the video interface bindings defined in
Documentation/devicetree/bindings/media/video-interfaces.txt.

Optional Properties:
- enable-gpios: reference to the GPIO connected to the REN (output enable) pin,
  if any.
- npwrdn-gpios: reference to the GPIO connected to the nPWRDN pin, if any.

Optionally, #address-cells, #size-cells, and port nodes can be grouped under a
ports node as described in Documentation/devicetree/bindings/graph.txt.

Example:

      csi0_deserializer: csi0_deserializer {
              compatible = "ti,scan921226h";

              enable-gpios = <&gpio5 20 GPIO_ACTIVE_HIGH>;
              npwrdn-gpios = <&gpio1 24 GPIO_ACTIVE_HIGH>;

              #address-cells = <1>;
              #size-cells = <0>;

              /* serial sink interface */
              port@0 {
                      reg = <0>;

                      des0_in: endpoint {
                              remote-endpoint = <&mt9v024_0_out>;
                      };
              };

              /* parallel source interface */
              port@1 {
                      reg = <1>;

                      des0_out: endpoint {
                              remote-endpoint = <&ipu1_csi0_mux_from_parallel_sensor>;
                              bus-width = <8>;
                              hsync-active = <1>;
                              vsync-active = <1>;
                      };
              };
      };
```

## Documentation/devicetree/bindings/misc/ti,scan921226h.yaml
```yaml
# SPDX-License-Identifier: (GPL-2.0 OR MIT)
# Copyright 2021 PHYTEC Messtechnik GmbH
%YAML 1.2
---
$id: "http://devicetree.org/schemas/misc/ti,scan921226h.yaml#"
$schema: "http://devicetree.org/meta-schemas/core.yaml#"

title: TI SCAN921226H LVDS Deserializer

maintainers:
  - Stefan Riedmueller <s.riedmueller@phytec.de>

description: |
  The TI SCAN921226H IC is a LVDS Deserializer.

properties:
  compatible:
    const: ti,scan921226h

  enable-gpios:
    maxItems: 1
    description:
      GPIO pin connected to the REN pin of the SCAN921226H

  powerdown-gpios:
    maxItems: 1
    description:
      GPIO pin connected to the NPWRDN pin of the SCAN921226H

  ti,boot-on:
    type: boolean
    description:
      Set if the deserializer shall be enabled during probe.


required:
  - compatible
  - enable-gpios
  - powerdown-gpios

additionalProperties: false

examples:
  - |
    csi_deserializer0: csi-deserializer0 {
         compatible = "ti,scan921226h";
         pinctrl-names = "default";
         pinctrl-0 = <&pinctrl_csi_des0>;

         enable-gpios = <&gpio5 20 GPIO_ACTIVE_HIGH>;
         powerdown-gpios = <&gpio3 9 GPIO_ACTIVE_HIGH>;

         ti,boot-on;
    };
```
